// These arguments were used when this file was generated. They will be automatically applied on subsequent loads 
// via the GUI or CLI invocations. Run CLI with '--help' for additional information on how to override these arguments.
// @cliArgs --board "/ti/boards/CC3220SF_LAUNCHXL" --product "SimpleLinkSDK@3.20.00.06"
// @versions {"data":"2019051709","timestamp":"2019051709","tool":"1.1.792","templates":"2019051709"}

var RTOS = scripting.addModule("/ti/drivers/RTOS");
var ADC = scripting.addModule("/ti/drivers/ADC");
var ADC1 = ADC.addInstance();
var Timer = scripting.addModule("/ti/drivers/Timer");
var Timer1 = Timer.addInstance();
var Timer2 = Timer.addInstance();
var GPIO = scripting.addModule("/ti/drivers/GPIO");
var GPIO1 = GPIO.addInstance();
var GPIO2 = GPIO.addInstance();
var GPIO3 = GPIO.addInstance();
var GPIO4 = GPIO.addInstance();
var GPIO5 = GPIO.addInstance();
var GPIO6 = GPIO.addInstance();
var GPIO7 = GPIO.addInstance();
var GPIO8 = GPIO.addInstance();
var UART = scripting.addModule("/ti/drivers/UART");
var UART1 = UART.addInstance();
var PWM = scripting.addModule("/ti/drivers/PWM");
var PWM1 = PWM.addInstance();
var GPIO9 = GPIO.addInstance();
var GPIO10 = GPIO.addInstance();
var GPIO11 = GPIO.addInstance();
// Name - The C/C++ identifier used in applications as the index parameter passed to ADC runtime APIs
ADC1.$name = "Board_ADC0";
// Name
ADC1.adc.$name = "MyADC1";
// Assign pin
ADC1.adc.adcPin.$assign = "boosterpack.2"; // P58*
var Board = scripting.addModule("/ti/drivers/Board");
// Name - The C/C++ identifier used in applications as the index parameter passed to Timer runtime APIs
Timer1.$name = "Board_TIMER0";
// Timer Type
Timer1.timerType = "32 Bits";
var Power = scripting.addModule("/ti/drivers/Power");
// Name
Power.parkPins.$name = "ti_drivers_power_PowerCC32XXPins0";
// Name
Timer1.timer.$name = "MyTimer1";
// Use Peripheral
Timer1.timer.$assign = "Timer0";
// Name - The C/C++ identifier used in applications as the index parameter passed to Timer runtime APIs
Timer2.$name = "Board_TIMER1";
// Timer Type
Timer2.timerType = "32 Bits";
// Name
Timer2.timer.$name = "MyTimer1";
// Use Peripheral
Timer2.timer.$assign = "Timer1";
// Name - The C/C++ identifier used in applications as the index parameter passed to GPIO runtime APIs
GPIO1.$name = "Board_GPIO0";
// Mode - Select the GPIO mode
GPIO1.mode = "Output";
// Assign pin
GPIO1.gpioPin.$assign = "boosterpack.30"; // P50
// Name - The C/C++ identifier used in applications as the index parameter passed to GPIO runtime APIs
GPIO2.$name = "Board_GPIO1";
// Mode - Select the GPIO mode
GPIO2.mode = "Output";
// Assign pin
GPIO2.gpioPin.$assign = "boosterpack.24"; // P60
// Name - The C/C++ identifier used in applications as the index parameter passed to GPIO runtime APIs
GPIO3.$name = "Board_GPIO2";
// Mode - Select the GPIO mode
GPIO3.mode = "Output";
// Assign pin
GPIO3.gpioPin.$assign = "boosterpack.5"; // P61
// Name - The C/C++ identifier used in applications as the index parameter passed to GPIO runtime APIs
GPIO4.$name = "Board_GPIO3";
// Mode - Select the GPIO mode
GPIO4.mode = "Output";
// Assign pin
GPIO4.gpioPin.$assign = "boosterpack.8"; // P62
// Name - The C/C++ identifier used in applications as the index parameter passed to GPIO runtime APIs
GPIO5.$name = "Board_GPIO4";
// Mode - Select the GPIO mode
GPIO5.mode = "Output";
// Assign pin
GPIO5.gpioPin.$assign = "boosterpack.27"; // P63
// Name - The C/C++ identifier used in applications as the index parameter passed to GPIO runtime APIs
GPIO6.$name = "Board_GPIO5";
// Mode - Select the GPIO mode
GPIO6.mode = "Output";
// Assign pin
GPIO6.gpioPin.$assign = "boosterpack.4"; // P03
// Name - The C/C++ identifier used in applications as the index parameter passed to GPIO runtime APIs
GPIO7.$name = "Board_GPIO6";
// Mode - Select the GPIO mode
GPIO7.mode = "Output";
// Assign pin
GPIO7.gpioPin.$assign = "boosterpack.7"; // P05
// Name - The C/C++ identifier used in applications as the index parameter passed to GPIO runtime APIs
GPIO8.$name = "Board_GPIO7";
// Mode - Select the GPIO mode
GPIO8.mode = "Output";
// Assign pin
GPIO8.gpioPin.$assign = "boosterpack.14"; // P06
// Name - The C/C++ identifier used in applications as the index parameter passed to UART runtime APIs
UART1.$name = "Board_UART0";
// Use Hardware - Select the hardware to use, or 'none' to use available header pins
UART1.$hardware = system.deviceData.board.components.xds110Uart;
// Name
UART1.uart.$name = "MyUART1";
// Name - The C/C++ identifier used in applications as the index parameter passed to PWM runtime APIs
PWM1.$name = "Board_PWM0";
// Use Hardware - Select the hardware to use, or 'none' to use available header pins
PWM1.$hardware = system.deviceData.board.components.LED_RED;
// Name
PWM1.timer.$name = "MyTimer1";
// Mode - Select the GPIO mode
GPIO9.mode = "Output";
// Name - The C/C++ identifier used in applications as the index parameter passed to GPIO runtime APIs
GPIO9.$name = "Board_GPIO8_TRIG";
// Assign pin
GPIO9.gpioPin.$assign = "boosterpack.19"; // P18
// Interrupt Trigger - Specifies when or if interrupts are triggered
GPIO10.interruptTrigger = "Both Edges";
// Mode - Select the GPIO mode
GPIO10.mode = "Dynamic";
// Callback Function - The name of the callback function called when this GPIO pin triggers an interrupt, or 'NULL' if it's specified at runtime
GPIO10.callbackFunction = "NULL";
// Name - The C/C++ identifier used in applications as the index parameter passed to GPIO runtime APIs
GPIO10.$name = "Board_GPIO9_LeftEcho";
// Mode - Select the GPIO mode
GPIO11.mode = "Dynamic";
// Callback Function - The name of the callback function called when this GPIO pin triggers an interrupt, or 'NULL' if it's specified at runtime
GPIO11.callbackFunction = "NULL";
// Name - The C/C++ identifier used in applications as the index parameter passed to GPIO runtime APIs
GPIO11.$name = "Board_GPIO10_RightEcho";
// Suggest solution
ADC1.adc.$suggestSolution = "ADC0";
// Suggest solution
UART1.uart.$suggestSolution = "UART0";
// Suggest solution
UART1.uart.txPin.$suggestSolution = "55";
// Suggest solution
UART1.uart.rxPin.$suggestSolution = "57";
// Suggest solution
PWM1.timer.$suggestSolution = "Timer2";
// Suggest solution
PWM1.timer.pwmPin.$suggestSolution = "64";
// Suggest solution
GPIO10.gpioPin.$suggestSolution = "7";
// Suggest solution
GPIO11.gpioPin.$suggestSolution = "8";
